## Documentation/devicetree/bindings/input/goodix-fingerprint.yaml
```yaml
# SPDX-License-Identifier: (GPL-2.0-only OR BSD-2-Clause)
%YAML 1.2
---
$id: http://devicetree.org/schemas/input/goodix-fingerprint.yaml#
$schema: http://devicetree.org/meta-schemas/core.yaml#

title: Goodix fingerprint sensor

maintainers:
  - Dawid Wróbel <me@dawidwrobel.com>

description: >
  A Goodix fingerprint sensor, described by the resources the operating system
  drives: the sensor's supply, its reset line and its interrupt.

  Where the sensor's SPI bus belongs to the secure world, image capture,
  template construction and matching are performed there by a trusted
  application, the SPI controller is not described to the operating system, and
  this node is all of the sensor that the operating system sees.

  The same properties describe the rest of the range. Only the compatibles
  listed have been tested; others should be added as they are.

properties:
  compatible:
    const: goodix,gf3626

  interrupts:
    maxItems: 1
    description: Finger down and up events.

  reset-gpios:
    maxItems: 1

  vdd-supply:
    description: Sensor supply, kept enabled while the sensor is in use.

  firmware-name:
    maxItems: 1
    description: >
      Where the sensor is driven from the secure world, the name of the trusted
      application that drives it, as loaded there. The pairing is a property of
      the board rather than of the sensor part, because the application is built
      and signed per device.

required:
  - compatible
  - interrupts
  - reset-gpios
  - vdd-supply

additionalProperties: false

examples:
  - |
    #include <dt-bindings/gpio/gpio.h>
    #include <dt-bindings/interrupt-controller/irq.h>

    fingerprint {
        compatible = "goodix,gf3626";

        interrupt-parent = <&tlmm>;
        interrupts = <23 IRQ_TYPE_EDGE_RISING>;

        reset-gpios = <&tlmm 125 GPIO_ACTIVE_LOW>;
        vdd-supply = <&vreg_l10a_3p0>;

        firmware-name = "gfenu";

        pinctrl-names = "default";
        pinctrl-0 = <&fp_int_default>;
    };
```

## Documentation/devicetree/bindings/soc/qcom/qcom,pmic-glink.yaml
```yaml
# SPDX-License-Identifier: (GPL-2.0-only OR BSD-2-Clause)
%YAML 1.2
---
$id: http://devicetree.org/schemas/soc/qcom/qcom,pmic-glink.yaml#
$schema: http://devicetree.org/meta-schemas/core.yaml#

title: Qualcomm PMIC GLINK firmware interface for battery management, USB
  Type-C and other things.

maintainers:
  - Bjorn Andersson <andersson@kernel.org>

description:
  The PMIC GLINK service, running on a coprocessor on some modern Qualcomm
  platforms and implement USB Type-C handling and battery management. This
  binding describes the component in the OS used to communicate with the
  firmware and connect it's resources to those described in the Devicetree,
  particularly the USB Type-C controllers relationship with USB and DisplayPort
  components.

properties:
  compatible:
    oneOf:
      - items:
          - enum:
              - qcom,glymur-pmic-glink
              - qcom,kaanapali-pmic-glink
              - qcom,qcm6490-pmic-glink
              - qcom,sc8180x-pmic-glink
              - qcom,sc8280xp-pmic-glink
              - qcom,sm8350-pmic-glink
              - qcom,sm8450-pmic-glink
              - qcom,sm8550-pmic-glink
          - const: qcom,pmic-glink
      - items:
          - enum:
              - qcom,hawi-pmic-glink
          - const: qcom,kaanapali-pmic-glink
          - const: qcom,pmic-glink
      - items:
          - enum:
              - qcom,sm7325-pmic-glink
          - const: qcom,qcm6490-pmic-glink
          - const: qcom,pmic-glink
      - items:
          - enum:
              - qcom,eliza-pmic-glink
              - qcom,milos-pmic-glink
              - qcom,sm8650-pmic-glink
              - qcom,sm8750-pmic-glink
              - qcom,x1e80100-pmic-glink
          - const: qcom,sm8550-pmic-glink
          - const: qcom,pmic-glink

  '#address-cells':
    const: 1

  '#size-cells':
    const: 0

  orientation-gpios:
    description: Array of input gpios for the Type-C connector orientation indication.
      The GPIO indication is used to detect the orientation of the Type-C connector.
      The array should contain a gpio entry for each PMIC Glink connector, in reg order.
      It is defined that GPIO active level means "CC2" or Reversed/Flipped orientation.

  oneplus,pps-read-buffer:
    type: boolean
    description:
      The battery-management firmware implements the OnePlus read-only PPS
      capability buffer request. This allows the operating system to retrieve
      the connected power source PDO table when standard UCSI PDO details are
      not advertised.

  oneplus,pps-fixed-5v:
    type: boolean
    description:
      The battery-management firmware implements the OnePlus fixed-PDO request
      used to return a connected USB PD source to 5 V. This development-only
      opt-in exposes only the fixed 5-V request, and requires the read-only PPS
      capability-buffer interface to verify that the source advertises 5 V.

  oneplus,pps-5v5-1a:
    type: boolean
    description:
      The battery-management firmware implements the OnePlus programmable-PDO
      voltage and current requests. This development-only opt-in exposes one
      fixed test request of 5.5 V at 1 A, verifies it against the advertised
      source APDOs, and requires the fixed 5-V fallback interface.

  oneplus,pps-ramp-9v-1a:
    type: boolean
    description:
      The battery-management firmware implements the OnePlus programmable-PDO
      voltage and current requests. This development-only opt-in exposes one
      source-only test which ramps from 5.5 V to 9 V in 0.5-V steps at 1 A.
      It does not enable any charge pump and requires both the 5.5-V test and
      fixed 5-V fallback interfaces.

  oneplus,pps-ramp-9v2-1a:
    type: boolean
    description:
      Development-only follow-up to the validated 9-V PPS ramp. It preserves
      the 5.5-V to 9-V ramp and then requests 9.1 V and 9.2 V in 100-mV steps,
      remaining capped at 1 A. It never enables a charge pump and requires the
      9-V ramp and fixed 5-V fallback interfaces.

  oneplus,pps-ramp-2to1-1a:
    type: boolean
    description:
      Development-only source request for a bounded 2-to-1 charge-pump test.
      It reads the live battery voltage, reproduces the downstream pump start
      target, adds a fixed allowance for measured source sag, and ramps PPS to
      that value at 1 A. It never enables a charge pump and requires the 9-V
      ramp and fixed 5-V fallback interfaces.

  oneplus,pps-run-2to1-5m:
    type: boolean
    description:
      Development-only end-to-end five-minute charge-pump test. It runs the
      validated gauge-derived 2-to-1 PPS feedback loop, hands control directly
      to the primary SC8547 charge pump through its power-supply callback without a
      userspace timing gap, and restores fixed 5 V when the bounded run ends or
      fails. It requires the 2-to-1 PPS ramp interface.

  oneplus,pps-policy-2to1-1a:
    type: boolean
    description:
      Development-only asynchronous single-primary charge policy. It uses the
      validated 2-to-1 PPS ramp at no more than 1.75 A, monitors USB attachment,
      battery voltage and battery temperature while the physical pump retains
      its local 500-ms safety checks, and supports an explicit stop request.
      Every exit disables and restores the pump before requesting fixed 5 V.
      The secondary pump remains off. It requires the five-minute end-to-end
      test interface.

  oneplus,pps-policy-auto-start:
    type: boolean
    description:
      Development-only opt-in that arms the validated single-primary 2-to-1
      policy on a physical source detach and starts it once on the next
      confirmed attachment. Startup additionally requires pump-side source
      presence, at least 4 V input, Qualcomm USB online state, battery voltage
      no higher than 4.20 V, and the existing battery-temperature window. A
      user stop suppresses restart until another detach, and startup failures
      are limited to three attempts per attachment. It requires the 2-to-1
      policy interface.

  oneplus,pps-secondary-500ms:
    type: boolean
    description:
      Development-only independent secondary charge-pump gate. It requires
      both physical pumps to begin off, runs the validated gauge-derived
      2-to-1 PPS ramp at no more than 1 A using the secondary pump ADC, checks
      again that the primary remains off at handoff, and enables only the
      secondary pump for one bounded 500-ms active sample. Every exit restores
      the secondary profile, requests fixed 5 V, and verifies both pumps off.
      It requires the 2-to-1 PPS ramp interface.

  oneplus,pps-dual-500ms:
    type: boolean
    description:
      Development-only staged dual-pump overlap gate. It prepares both pumps
      at fixed 5 V, waits one second and rechecks both off, then performs one
      gauge-derived 2-to-1 PPS ramp capped at 1.75 A. A cold initialized
      primary gets the same bounded ADC-ready retries as the secondary before
      the ramp proceeds. The dual ramp allows two additional feedback samples
      to confirm the unchanged narrow handoff window. It then
      starts the primary for seven seconds, and requires the primary to remain
      active while the secondary runs for five seconds. After both pumps pass
      active/current checks, it follows the vendor third-party PPS control
      shape: raise the shared PPS voltage in at most five 40-mV steps at 3 A,
      wait 500 ms and check both pumps after each step, then stop when aggregate
      pump IBUS is within 100 mA of 2 A. It never exceeds a 200-mV increase and
      returns the request to the baseline voltage at 1.75 A before either run
      finishes.
      Every exit cancels any active primary run, restores both pump profiles,
      requests fixed 5 V, and verifies both pumps off. It requires the
      independent secondary-pump gate.

  nvmem-cells:
    minItems: 3
    maxItems: 3
    description:
      The nvmem cells contain the charge control settings, including the charge control
      enable status, the battery state of charge (SoC) threshold for stopping charging,
      and the battery SoC delta required to restart charging.

  nvmem-cell-names:
    items:
      - const: charge_limit_en
      - const: charge_limit_end
      - const: charge_limit_delta

patternProperties:
  '^connector@\d$':
    $ref: /schemas/connector/usb-connector.yaml#
    required:
      - reg

required:
  - compatible

additionalProperties: false

examples:
  - |+
    pmic-glink {
        compatible = "qcom,sc8280xp-pmic-glink", "qcom,pmic-glink";

        #address-cells = <1>;
        #size-cells = <0>;

        connector@0 {
            compatible = "usb-c-connector";
            reg = <0>;
            power-role = "dual";
            data-role = "dual";

            ports {
                #address-cells = <1>;
                #size-cells = <0>;

                port@0 {
                    reg = <0>;
                    endpoint {
                        remote-endpoint = <&usb_role>;
                    };
                };

                port@1 {
                    reg = <1>;
                    endpoint {
                        remote-endpoint = <&ss_phy_out>;
                    };
                };

                port@2 {
                    reg = <2>;
                    endpoint {
                        remote-endpoint = <&sbu_mux>;
                    };
                };
            };
        };
    };
...
```

## drivers/tee/qseecom/Kconfig
```kconfig
# SPDX-License-Identifier: GPL-2.0-only
# Qualcomm QSEECOM TEE driver
config TEE_QSEECOM
	tristate "Qualcomm QSEECOM TEE driver"
	depends on QCOM_QSEECOM
	depends on !CPU_BIG_ENDIAN
	depends on QCOM_MDT_LOADER
	help
	  This exposes QSEE applications reached over the legacy QSEECOM
	  interface through the TEE subsystem, so that user space can open a
	  session to a trusted application and invoke commands in it.

	  This is the command-based Qualcomm interface, as distinct from the
	  object-based smcinvoke interface served by the QCOMTEE driver. The
	  two are not alternative routes to the same applications: a trusted
	  application is built against one or the other, so what a system needs
	  is decided by the applications in its firmware rather than by the age
	  of its SoC. Platforms offering both interfaces are common, and may
	  still carry applications that answer only over QSEECOM.

	  Say Y if the firmware carries such applications. See
	  Documentation/tee/qseecom.rst.

	  Note that the driver cannot validate what a command means, because it
	  does not know any application's payload format: anyone who can open
	  the client device may send arbitrary commands to any loaded trusted
	  application. Restrict access to the device nodes accordingly. See
	  Documentation/tee/qseecom.rst.
```
